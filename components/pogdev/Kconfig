## components/pogdev/Kconfig
```kconfig
menu "POG device integration"

    config POGDEV_HOME_FALLBACK_URL
        string "Fallback POG Home URL"
        default ""
        help
            Optional base URL used when _poghome._tcp remains undiscovered for
            30 seconds. Protocol v1 accepts an HTTP URL such as
            http://192.168.1.20:8090. Leave empty to rely exclusively on mDNS.

endmenu
```

## components/pogmic/Kconfig
```kconfig
menu "POG microphone"
    config POG_MICROPHONE
        bool "Build optional I2S microphone capture"
        depends on IDF_TARGET_ESP32 || IDF_TARGET_ESP32S3
        default n
        help
            Digital I2S microphones with signed 24-bit data in 32-bit slots
            (for example INMP441 or ICS-43434). Uses I2S1 as a separate
            master or a receiver following AirPlay's I2S0 clock.
            No capture at boot and no network audio streaming.
            Confirm the physical wiring before setting the GPIOs below.

    if POG_MICROPHONE
        config POG_MIC_SHARED_CLOCKS
            bool "Microphone shares the speaker BCLK and WS"
            depends on IDF_TARGET_ESP32 && AUDIO_OUTPUT_I2S && !BT_A2DP_ENABLE
            default n
            help
                I2S0 remains the only clock master. I2S1 receives as a slave
                at the speaker sample rate; speaker slots become 32-bit.
                Both microphone clock GPIOs must match the speaker exactly.
                The output must be initialized before a local capture test.
        config POG_MIC_BCLK_GPIO
            int "Microphone BCLK GPIO (-1 = unconfigured)"
            range -1 48
            default -1
        config POG_MIC_WS_GPIO
            int "Microphone WS GPIO (-1 = unconfigured)"
            range -1 48
            default -1
        config POG_MIC_DATA_GPIO
            int "Microphone data input GPIO (-1 = unconfigured)"
            range -1 48
            default -1
        config POG_MIC_RIGHT_SLOT
            bool "Read right slot (microphone L/R tied high)"
            default n
    endif
endmenu
```

## components/pogvoice/Kconfig
```kconfig
menu "POG voice satellite"
    config POG_VOICE
        bool "Enable the POG AI push-to-talk satellite"
        depends on POG_MIC_SHARED_CLOCKS
        default n
        help
            Explicit listen/stop/cancel controls, authenticated enrolment,
            Opus over WebSocket v3 and spoken replies. No wake word or AEC.
            Microphone streaming never starts automatically after boot.
endmenu
```

## components/pogwake/Kconfig
```kconfig
menu "POG local wake word"
config POG_WAKEWORD
    bool "Local microWakeWord detector"
    depends on POG_VOICE && (IDF_TARGET_ESP32 || IDF_TARGET_ESP32S3)
    default n
    help
        Recognizes a selected bundled wake word locally. No ambient audio is
        transmitted while waiting. Runtime activation requires administrator
        consent and is disabled by default.
endmenu
```
